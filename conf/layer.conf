## conf/layer.conf
```bitbake
# We have a conf and classes directory, add to BBPATH
BBPATH .= ":${LAYERDIR}"

# We have recipes directories, add to BBFILES
BBFILES += "${LAYERDIR}/recipes-*/*/*.bb ${LAYERDIR}/recipes-*/*/*.bbappend"

BBFILE_COLLECTIONS += "httpsguard"
BBFILE_PATTERN_httpsguard = "^${LAYERDIR}/"
BBFILE_PRIORITY_httpsguard = "7"
LAYERVERSION_httpsguard = "1"

LAYERDEPENDS_httpsguard = "core"
LAYERDEPENDS_httpsguard += "openembedded-layer"
LAYERDEPENDS_httpsguard += "networking-layer"
LAYERDEPENDS_httpsguard += "meta-python"
LAYERDEPENDS_httpsguard += "security"
LAYERDEPENDS_httpsguard += "phosphor-layer"
LAYERDEPENDS_httpsguard += "aspeed-layer"

LAYERSERIES_COMPAT_httpsguard = "kirkstone mickledore nanbield scarthgap styhead blacksail wrynose"
```
